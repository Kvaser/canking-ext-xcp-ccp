ASAP2_VERSION 1 71
/begin PROJECT SampleECU "Example CCP project used for development and testing"
/begin HEADER "Generic sample data" VERSION "1.0" PROJECT_NO SAMPLE_CCP /end HEADER
/begin MODULE SampleECU "Example module with a representative measurement set"
/begin MOD_COMMON "" BYTE_ORDER MSB_FIRST /end MOD_COMMON
/begin IF_DATA ASAP1B_CCP
 /begin RASTER "Raster_10ms" /* name */ "10ms" /* short name */ 0x1 /* CCP event channel number */ 0x4 /* basic scaling unit (CSE) */ 0x1 /* ECU sample rate */ /end RASTER
 /begin RASTER "Raster_100ms" /* name */ "100ms" /* short name */ 0x2 /* CCP event channel number */ 0x5 /* basic scaling unit (CSE) */ 0x1 /* ECU sample rate */ /end RASTER
 /begin TP_BLOB 0x0201 /* CCP version */ 0x0206 /* transport layer blob version */ 0x00000010 /* CRO CAN id */ 0x00000011 /* DTO CAN id */ 0x0001 /* station address */ 0x0002 /* byte order: low byte first */ BAUDRATE 500000 /* BAUDRATE */ DAQ_MODE BURST /* ECU sends a complete DAQ list per cycle */ BYTES_ONLY /* every DAQ element is byte-sized */ /end TP_BLOB
/end IF_DATA
/begin MEASUREMENT CpuLoad_pct "CPU load" FLOAT32_IEEE CpuLoad_pct_CM 0 0 0 100 ECU_ADDRESS 0x3F000100 /end MEASUREMENT
/begin MEASUREMENT SupplyVoltage_V "Supply rail voltage" FLOAT32_IEEE SupplyVoltage_V_CM 0 0 0 20 ECU_ADDRESS 0x3F000110 /end MEASUREMENT
/begin MEASUREMENT SerialNumber "ECU serial number" UWORD SerialNumber_CM 0 0 0 65535 ECU_ADDRESS 0x3F000120 /end MEASUREMENT
/begin MEASUREMENT RunTime_Raw "Cumulative run time, seconds" ULONG RunTime_Raw_CM 0 0 0 4294967295 ECU_ADDRESS 0x3F000130 /end MEASUREMENT
/begin MEASUREMENT Raw_Throttle1 "Throttle sensor 1, raw ADC counts" UWORD Raw_Throttle1_CM 0 0 0 4095 ECU_ADDRESS 0x3F000140 /end MEASUREMENT
/begin MEASUREMENT Pedal1 "Pedal sensor 1" FLOAT32_IEEE Pedal1_CM 0 0 0 1 ECU_ADDRESS 0x3F000150 /end MEASUREMENT
/begin MEASUREMENT OilTemp_Raw "Oil temperature, raw signed counts" SWORD OilTemp_Raw_CM 0 0 -32768 32767 ECU_ADDRESS 0x3F000170 /end MEASUREMENT
/begin MEASUREMENT v_10V_Raw "10V rail, raw ADC counts" UWORD Raw_ADC_CM 0 0 0 65535 BIT_MASK 0xFFFF ECU_ADDRESS 0x3F000160 /end MEASUREMENT
/begin MEASUREMENT v_5V_Raw "5V rail, raw ADC counts" UWORD Raw_ADC_CM 0 0 0 65535 BIT_MASK 0xFFFF ECU_ADDRESS 0x3F000162 /end MEASUREMENT
/begin MEASUREMENT v_10 "10V rail, scaled" FLOAT32_IEEE v_10_CM 0 0 0 15 /begin VIRTUAL v_10V_Raw /end VIRTUAL /end MEASUREMENT
/begin MEASUREMENT v_5 "5V rail, scaled" FLOAT32_IEEE v_5_CM 0 0 0 10 /begin VIRTUAL v_5V_Raw /end VIRTUAL /end MEASUREMENT
/begin MEASUREMENT RunHours "Run time, hours" UBYTE RunHours_CM 0 0 0 255 /begin VIRTUAL RunTime_Raw /end VIRTUAL /end MEASUREMENT
/begin MEASUREMENT RunMinutes "Run time, minutes" UBYTE RunMinutes_CM 0 0 0 59 /begin VIRTUAL RunTime_Raw /end VIRTUAL /end MEASUREMENT
/begin MEASUREMENT RunTimeSeconds "Run time, hours+minutes+seconds combined" FLOAT32_IEEE RunTimeSeconds_CM 0 0 0 4294967295 /begin VIRTUAL RunTime_Raw RunHours RunMinutes /end VIRTUAL /end MEASUREMENT
/begin COMPU_METHOD CpuLoad_pct_CM "linear, identity" RAT_FUNC "%3.1" "%" COEFFS 0 1 0 0 0 1 /end COMPU_METHOD
/begin COMPU_METHOD SupplyVoltage_V_CM "linear, identity" RAT_FUNC "%3.2" "V" COEFFS 0 1 0 0 0 1 /end COMPU_METHOD
/begin COMPU_METHOD SerialNumber_CM "linear, identity" RAT_FUNC "%5.0" "" COEFFS 0 1 0 0 0 1 /end COMPU_METHOD
/begin COMPU_METHOD RunTime_Raw_CM "linear, identity" RAT_FUNC "%10.0" "s" COEFFS 0 1 0 0 0 1 /end COMPU_METHOD
/begin COMPU_METHOD Raw_Throttle1_CM "linear, identity" RAT_FUNC "%4.0" "Counts" COEFFS 0 1 0 0 0 1 /end COMPU_METHOD
/begin COMPU_METHOD Pedal1_CM "linear, identity - ECU already stores the ratio as a float" RAT_FUNC "%1.3" "" COEFFS 0 1 0 0 0 1 /end COMPU_METHOD
/begin COMPU_METHOD OilTemp_Raw_CM "linear, identity" RAT_FUNC "%5.0" "degC" COEFFS 0 1 0 0 0 1 /end COMPU_METHOD
/begin COMPU_METHOD Raw_ADC_CM "linear, identity" RAT_FUNC "%5.0" "Counts" COEFFS 0 1 0 0 0 1 /end COMPU_METHOD
/begin COMPU_METHOD VoltageRef_CM "unit reference for VIRTUAL_CONVERSION" RAT_FUNC "%2.3" "volts" COEFFS 0 1 0 0 0 1 /end COMPU_METHOD
/begin COMPU_METHOD v_10_CM "" FORM "%2.3" "" /begin FORMULA "X1*15/16383" /end FORMULA /end COMPU_METHOD
/begin COMPU_METHOD v_5_CM "" FORM "%2.3" "" /begin FORMULA "X1*10/16383" /end FORMULA /end COMPU_METHOD
/begin COMPU_METHOD RunHours_CM "" FORM "%3.0" "h" /begin FORMULA "X1/3600" /end FORMULA /end COMPU_METHOD
/begin COMPU_METHOD RunMinutes_CM "" FORM "%2.0" "min" /begin FORMULA "X1/60" /end FORMULA /end COMPU_METHOD
/begin COMPU_METHOD RunTimeSeconds_CM "" FORM "%10.0" "s" /begin FORMULA "X1+X2+X3" /end FORMULA /end COMPU_METHOD
/begin GROUP SampleECU "All measurements in this project" ROOT /begin SUB_GROUP Diagnostics PowerSupply Throttle RunTime /end SUB_GROUP /end GROUP
/begin GROUP Diagnostics "ECU health and identification" /begin REF_MEASUREMENT CpuLoad_pct SerialNumber /end REF_MEASUREMENT /end GROUP
/begin GROUP PowerSupply "Supply rail voltages, raw and scaled" /begin REF_MEASUREMENT SupplyVoltage_V v_10V_Raw v_5V_Raw v_10 v_5 /end REF_MEASUREMENT /end GROUP
/begin GROUP Throttle "Throttle and oil temperature sensors" /begin REF_MEASUREMENT Raw_Throttle1 Pedal1 OilTemp_Raw /end REF_MEASUREMENT /end GROUP
/begin GROUP RunTime "Cumulative and split run time" /begin REF_MEASUREMENT RunTime_Raw RunHours RunMinutes RunTimeSeconds /end REF_MEASUREMENT /end GROUP
/end MODULE
/end PROJECT
